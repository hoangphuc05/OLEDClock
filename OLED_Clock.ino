/*

*/
#include <Arduino.h>
#include <U8g2lib.h>
#ifdef U8X8_HAVE_HW_SPI
#include <SPI.h>
#endif
#ifdef U8X8_HAVE_HW_I2C
#include <Wire.h>
#endif

#include <DS3231.h>


//U8X8_SH1106_128X64_NONAME_HW_I2C u8x8(/* reset=*/ U8X8_PIN_NONE);
U8G2_SH1106_128X64_NONAME_1_HW_I2C u8g2(U8G2_R0, /* reset=*/ U8X8_PIN_NONE);
DS3231  rtc(SDA, SCL);
Time  t;

char currentTime;
unsigned long hour = 0;
unsigned long min = 0;
unsigned long sec = 0 ;
unsigned long mid = 0;
unsigned long midH = 0;
int v = 0;
int k = 0;
int val=0;
int inputPin = 16;

//unsigned long currentMillis = millis();
unsigned long previousMillis = 0;


void getTime() {
  t = rtc.getTime();
  currentTime = (t.hour*3600 + t.min*60 + t.sec);
}

/*void timeMake() {
  //setTime = hour*3600*1000 + min*60*1000+sec*1000;
  //Serial.println((setTime +millis() - startTime)/1000);
  currentTime = (setTime +millis() - startTime)/1000;
  //Serial.println(currentTime);
  mid = currentTime / 60;
  midH = mid /60;
  sec = currentTime - (mid*60);
  min = mid - midH*60;
  day = midH / 24;
  hour = midH - day*24;
}*/
void printTime() {
 u8g2.setFont(u8g2_font_helvR18_tn);
  u8g2.setCursor(20, 27);
  u8g2.print(rtc.getTimeStr());
}

void printDay() {
  //u8g2.setFont(u8g2_font_timR12_tn);
  u8g2.setFont(u8g2_font_timR10_tn);
  u8g2.setCursor(0, 64);
  u8g2.print(rtc.getDateStr());
}

void printTempt() {
  u8g2.setFont(u8g2_font_timR10_tr);
  //u8g2.setFont(u8g2_font_timR12_tn);
  u8g2.setCursor(78, 64);
  u8g2.print(rtc.getTemp());
  //u8g2.print("o");
  
  u8g2.setFont(u8g2_font_timR08_tr);
  u8g2.setCursor(111,58);
  u8g2.print('o');
  u8g2.setFont(u8g2_font_timR10_tr);
  u8g2.setCursor(115,64);
  u8g2.print('C');
  
}

void setup() {
  //Serial.begin(115200);
  rtc.begin();
  u8g2.begin();
  pinMode(A3, INPUT);
  
}

void loop() {
  unsigned long currentMillis = millis();
  //unsigned long previousMillis = 0;
  val = digitalRead(A3);
  if (val == HIGH){
    //Serial.println("Highhh");
    u8g2.setPowerSave(0);
    previousMillis=currentMillis;
  }
  if (val == LOW){
    //Serial.println("Lowww");
    if (currentMillis-previousMillis >= 300000){
      u8g2.setPowerSave(1);
    }
    
  }
  //u8g2.setPowerSave(1);
  //rtc.getTimeStr() 
  u8g2.drawLine(0, 38, 128, 38);
  if (rtc.getTimeStr() != currentTime) {
    currentTime=rtc.getTimeStr();
  u8g2.firstPage();
  do {
    u8g2.setContrast(35);
    
    u8g2.drawLine(0, 38, 128, 38);
    
    /*if ((k <128) and (v==0)) {
      k++;
    }
    if ((k >= 128) and (v <128)){
      v++;
    }
    if ((k>=128) and (v>=128)){
      v = 0;
      k = 0;
    }*/
    //Serial.println(n);
    printTime();
    printDay();
    printTempt();
  } while ( u8g2.nextPage() );
  }
  //currentTime=millis();
  //}
  //delay (500);
 
}
